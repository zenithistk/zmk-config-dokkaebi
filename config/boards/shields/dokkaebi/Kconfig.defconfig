## config/boards/shields/dokkaebi/Kconfig.defconfig
```kconfig
if SHIELD_DOKKAEBI_LEFT

config ZMK_KEYBOARD_NAME
    default "dokkaebi"

config ZMK_SPLIT_ROLE_CENTRAL
    default y

endif

if SHIELD_DOKKAEBI_LEFT || SHIELD_DOKKAEBI_RIGHT

config ZMK_SPLIT
    default y

config CONFIG_BT_CTLR_TX_PWR_PLUS_8
    default y

config CONFIG_BT_GATT_ENFORCE_SUBSCRIPTION
    default y

endif
```

## config/west.yml
```yaml
manifest:
  remotes:
    - name: jgreel
      url-base: https://github.com/jgreel
  projects:
    - name: zmk
      remote: jgreel
      revision: mouse-3.2-pim447
      import: app/west.yml
  self:
    path: config
```
